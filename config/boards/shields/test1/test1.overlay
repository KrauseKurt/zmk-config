#include <dt-bindings/zmk/matrix_transform.h>

/ {
    chosen {
        zmk,kscan = &default_kscan;
        zmk,matrix-transform = &default_transform;
    };

    default_kscan: kscan {
        compatible = "zmk,kscan-gpio-matrix";
        label = "default_kscan";
        diode-direction = "col2row";
        
        row-gpios = <&pro_micro 6 (GPIO_ACTIVE_HIGH | GPIO_PULL_DOWN)>;

        col-gpios = <&pro_micro 4 GPIO_ACTIVE_HIGH>;

    };

    default_transform: matrix_transform {
        compatible = "zmk,matrix-transform";
        columns = <1>;
        rows = <1>;

        map = <
            RC(0,0)
        >;
    };
};